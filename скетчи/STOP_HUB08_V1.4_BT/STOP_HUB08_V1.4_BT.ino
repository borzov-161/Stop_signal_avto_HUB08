/*HUB08-Pin | Arduino Pin | Note
  LA / A  |     4       | Line select A
  LB / B  |     5       | Line select B 
  LC / C  |     6       | Line select C
  LD / D  |     7       | Line select D
  CLK     |   13 (SCK)  | Serial clock
  R1 / R  |   11 (MOSI) | Serial Data (Red pixels)
  OE / EN |     3       | Output Enable (PWM brightness control)
 LAT / STB|     2       | Latch//*/
#include <avr/pgmspace.h>
#include <SPI.h>
#include "HUB08SPI.h"
#include <TimerOne.h>
//выбираем шрифт
//#include "Font_RUS1.h"  //English широкий + русский узкий
#include "Font_RUS2.h"    //English срений + русский средний
//#include "Font_RUS3.h"  //English срений + русский узкий
#define WIDTH   64
#define HEIGHT  16
#include <EEPROM.h>       // подключаем библиотеку EEPROM 
uint8_t displaybuf[WIDTH * HEIGHT / 8];

HUB08SPI display;
//=========================== рисунок ==WORD OF TANK====================================================//
//рисунок меняем под себя в приложении EXCEL
//если не нужен декларируем три строчки ниже в void setup(), и одну ниже
/* стереть справа , и нет рисунка->  */
uint8_t display_risunok[WIDTH * HEIGHT / 8] = {
128,0,1,255,255,192,0,1,
0,0,7,0,0,112,0,0,
0,0,28,127,255,28,0,0,
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128,0,0,15,120,0,0,1
};///*/
 // ----------флаги, менять нет смысла. это внутренние переменные---------------------------  
unsigned long    taimer_telf=0;  //врЕменные таймеры
boolean  rezt=0, //флаги //
        flag_tel=0, flag_len=0, new_fraza=0; ////флаги //
uint8_t len=0,msg_N=3;      //переменные// менять тут ничего не надо
int length = WIDTH;                               //переменная для длины фраз
String Str_telf;                                  //объект для конвертирования массива телефоных фраз
char * msg_tel;                                   //резервируем память под массив фраз с телефона
//--------если хотим менять, то фразы должны помещатся на табло и нужно уметь указать отступ
char *msg_avto[] = //массив автомобиля//пока В РАЗРАБОТКЕ оптимизация положения
 {/////////сервисные фразы. //////////////////:)/// буквы "Ё" нет!   "\x020" - это пробел
  "your text1",    //0/// знак " /!\  " //then write something of their own//center do gaps
  "your text2"    //1// знак шины "Ш"  //then write something of their own
  };

//------- настройки-можно менять под свои желания------------------------------------------
// Библиотека увеличивает частоту Timer2 так что ШИМ работает на 32 кГц. время в скетче бежит быстрее :) 
unsigned long  time_sbros =15000; //время горения фраз с телефона////потом  меняем с телефона 
uint16_t Skorost=150;             //от 30 до 300//0-бысто, 700 медлено//потом меняем с телефона 
uint8_t Jarkost=255;              //0-255//255 max//потом с телефона меняем

//---------------переменные для хранения в EEPROM ------------------------
// тут тип переменной "int" для корректной работы функции "sscanf()"
// все меняется с телефона потом
//обязательно хоть раз "сохранить" нажать, а то в памяти(до первой записи) может быть мусор
int adrees=0;    //адрес ардуино,не меняется//29284 прописано в проге телефона (от фоноря придумал)
int skorost=70;  //скорость(10-99)//99 быстро 10-медлено//
int jarkost=70;  //яркость(10-99)
int inver_zadan=3;    // инверсия//0-9
int reklam=1;    // режим когда фразы не уходят сами//1-уходят,2- постоянно горит последняя фраза,до выкл табло
int vremya=15;   //время горения фраз с телефона// сек//2-99
int coxpan=1;    //сохранить еером//1-нет//2- да
int begut=1;     // бежит//1-нет//2- да//
int shipu=1;     //1-знак /!/, 2-буква "Ш" 

//================================================================================================//
void setup()
{   Serial.begin(9600);    // для блютуз СН-06
 // Serial.begin(38400);   // для блютуз СН-05
 //------------чтение сохранненых переменных их энергонезависимой памяти --------------------
if (EEPROM.read(61)==177){ // 61- ячейка как флаг,пока мы ни разу не сохранялись,то настройки по умолчанию (не из памяти)
skorost=EEPROM.read(51);  jarkost=EEPROM.read(52); reklam=EEPROM.read(53); 
 vremya=EEPROM.read(54);  begut = EEPROM.read(55);  shipu=EEPROM.read(56); inver_zadan=EEPROM.read(57);
   // применяем сохраненные переменные 
      Skorost=map(skorost, 10, 99, 300, 30);   //ивертирует диапазон , после новой команды.
      Jarkost=map(jarkost, 10, 99, 40, 255);   //ивертирует диапазон , после новой команды
      time_sbros=(long)vremya*1000;            /// переводим сек в млсек*/
}
//----------------прерывания--------------------------------------------------------------- 
    Timer1.initialize(200);                    //частота обновления экрана//влияет на  скорость
    Timer1.attachInterrupt(refresh);           //скорость обновления
//---------печатаем рисунок---если не нужен рисунок, то закоменитироть 3 сторки ниже-------
/*стереть справа ->  */
 display.begin(display_risunok, WIDTH, HEIGHT);//инициализация дисплея
 delay(1000);                                  //рисунок горит 1(1000mc) секунд при старте
 display.clear();                              //чистим дисплей  */
//--------------------------------------------------------------------------------------
 display.begin(displaybuf, WIDTH, HEIGHT);//выводим из функции рисунок, прописываем в функцию буфер для текста 
}

//------------------------------------------------------------------------
volatile uint16_t Nx = 0;    //переменная позиции печати на табло//не разрешаем опримизировать переменную//

void refresh()               //функция обновления строки,(прерывания таймера)
{ static uint16_t count = 0; count++;
if (count > Skorost)
   { count= 0; Nx++;
    if(Nx > length) Nx = 0;  //reset после xxx pixels
   } 
  display.scan();//refresh//обновить одну строку дисплея
}

//=====================================================================================================
void loop() 
{ 
  unsigned long new_time = millis();//текущее время работы скетча в млсек
//----------------- прием по блютуз фраз и команд ----------------------------=
if (Serial.available() !=0)             /// если данные пришли по блютуз
{   Str_telf = Serial.readString();     //читаем буфер порта
    display.clear(); new_fraza=0;Nx=0;  //чистим табло//
    flag_tel=1;                         //опрокидываем флаг и запрещаем работу от вх. машины
    taimer_telf = new_time;              ///запоминаем время когда пришла новая фраза с телефона
}
if (flag_tel==1)                      //обрабатываем то, что пришло с телефона
{
   len= Str_telf.length() ;           //считаем длину
   msg_tel = Str_telf.c_str();        //преобразовываем массив String в массив char
   sscanf(msg_tel, "%d,", &adrees);   ///берем 5 символов//это код команд
//---------------------управление-----------------------------------------------
 if (adrees == 29284 && len>22&&len<26)  //если пришла команда разгбераем её на части отделенные запятой
   {
    sscanf(msg_tel, "%d,%d,%d,%d,%d,%d,%d,%d,%d",//берем в десятичном значении
     &adrees, &skorost,  &jarkost,&inver_zadan,&begut, &vremya, &coxpan, &reklam, &shipu );// переменные
     //--1-------2---------3--------------4-------5-------6---------7-------8--------9---  № п/п
     //29284----70--------70-- -----------0-------1-------15--------2-------1--------1--- значения(пример)
     //29284,70,70,0,1,15,2,1,1   // ПРИМЕР для записи EEPROM через порт//29284-прописан в программе телефона(меняется.только в app.invertor2) 
 //хоть разок вставляем ПРИМЕР в порт и отправляеем,дабы перезаписать мусор в ячейках памяти//разово делается//можно с телефона
      Skorost=map(skorost, 10, 99, 300, 30); //ивертирует диапазон , после новой команды.
      Jarkost=map(jarkost, 10, 99, 40, 255); //ивертирует диапазон , после новой команды
      time_sbros=(long)vremya*1000; /// переводим сек в млсек*/
      display.setBrightness(Jarkost); //устанавливаем яркость
   if(coxpan==2)  //если пришла команда записать//седьмая позиция в команде
     {// если значения новые, перезаписываем их.
      EEPROM.update(51, skorost);EEPROM.update(52, jarkost); EEPROM.update(53, reklam);
      EEPROM.update(54, vremya); EEPROM.update(55, begut);   EEPROM.update(56, shipu);
      EEPROM.update(57, inver_zadan);      //инверсия стопа
      EEPROM.update(61, 177);         // как флаг того - что были сохранены настройки 
     }//51,52..56,61, 177-- от фоноря взял //лишь бы не первые//
   
    flag_tel=0; adrees = 0;  //выходим из записи
    display.clear();         //стираем фразу
    length = WIDTH;          //делаем длину "64", для фраз от машины
   } //
 else //если это была не команда- печатаем текст,
  { if (!new_fraza && flag_len)         //разово-только при новой фразе
      {printString(msg_tel,WIDTH,0);    //помещяем фразу в буфер
       new_fraza=1; flag_len=0;         //считаем длину фразы до старта анимации.   
       display.clear();                 //стираем, ранний старт
      }//
  //БЕЖАТЬ, ИЛИ НЕ БЕЖАТЬ? ВОТ, В ЧЕМ ВОПРОС!
    if (length <= WIDTH  && begut!=2) printString(msg_tel,0,0);//статика
    else printString(msg_tel,WIDTH-Nx,0);                      //бегущая строка
  }
if (new_time - taimer_telf >= time_sbros && flag_tel && !Nx && reklam !=2)//если не вкл реклама
  {flag_tel=0; length = WIDTH ; display.clear();                         //стираем фразу телефона если время горения истекло
   rezt=0;                                                               //флаг готовности. для вкл знака треугольник(или шипы)
  }// если вкл режим "реклама" , то ниже по скетчу мы не опускаемся :)//тут остаемся т.к. флаг "flag_tel" не сбрасывается
}
else if (!flag_tel  ) //
    { 
      if (!rezt)  
       {display.setBrightness(Jarkost);  //устанавливаем яркость//
        display.clear(); rezt=1;         // разочек стираем буфер
       }
     if      (rezt && shipu !=2) printString(msg_avto[0],0,0); // пишем, знак /!/
     else if (rezt && shipu ==2) printString(msg_avto[1],0,0); // пишем букву "Ш" (крупную).
    }
} ///конец а, кто читал тот молодец 
//=====================================================================================================================
